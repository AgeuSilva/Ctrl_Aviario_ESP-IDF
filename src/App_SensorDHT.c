/*=============================================================================================================================
    Init Includes Files ANSI C
=============================================================================================================================*/
#include <stdio.h>
#include <stdlib.h>
#include <stddef.h>
#include <string.h>
#include <stdbool.h>
#include "_ansi.h"
/*=============================================================================================================================
    End Includes Files ANSI C
=============================================================================================================================*/

/*=============================================================================================================================
    Init Includes Files ESP32
=============================================================================================================================*/
#include <esp_system.h>
#include <nvs_flash.h>
#include <esp_event_loop.h>
#include <esp_log.h>
#include "driver/gpio.h"
#include <driver/ledc.h>
/*=============================================================================================================================
    End Includes Files ESP32
=============================================================================================================================*/

/*=============================================================================================================================
    Init Includes Filess DHT22
=============================================================================================================================*/
#include "App_SensorDHT.h"
#include "Lib_Dht11.h"
/*=============================================================================================================================
    End Includes Filess DHT22
=============================================================================================================================*/

#define PIN_DADOS_DHT22 GPIO_NUM_4
#define PIN_DADOS_DHT11 GPIO_NUM_4

/*=============================================================================================================================
    Init Handle of Tasks
=============================================================================================================================*/
TaskHandle_t xSensorDHT = 0;
/*=============================================================================================================================
    End Handle of Tasks
=============================================================================================================================*/

dht_t s_SensorDHT;

void vConfigSensorDHT(void)
{
    /* atribui pino de dados de entrada do sensor */
    DHT11_init(PIN_DADOS_DHT11);
    
    //criação de fila do xSerialControl -- TaskControl
  	xSensor_Saidas = xQueueCreate( 10, sizeof( dht_t ) );
    if(xSensor_Saidas == NULL)
    {
  		ESP_LOGE("Erro", "Erro na criação da Queue.\n");
  	}
    
    xTaskCreate(&vSensorDHT, "vSensorDHT22", configMINIMAL_STACK_SIZE + 4096, NULL, 1, xSensorDHT);
}

void vAppSensorDHT(void)
{
    while (true)
    { 
        s_SensorDHT.u16_Temperatura = DHT11_read().temperature;
        s_SensorDHT.u16_Umidade = DHT11_read().humidity;
        s_SensorDHT.u8_Status = DHT11_read().status;

        if(s_SensorDHT.u16_Temperatura != -1 && s_SensorDHT.u16_Umidade != -1)
        {
            xQueueSend(xSensor_Saidas, &s_SensorDHT, 10); 

            vTaskDelay(pdMS_TO_TICKS(5000)); /* Delay de 5 segundos */
        }
    }
}

/*=============================================================================================================================
    Init Tasks FreeRTOS
=============================================================================================================================*/
void vSensorDHT(void *pvParameter)
{
    (void) pvParameter;
    vAppSensorDHT();
}
/*=============================================================================================================================
    End Tasks FreeRTOS
=============================================================================================================================*/